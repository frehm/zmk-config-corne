## boards/shields/handwired_corne/Kconfig.defconfig
```kconfig
if SHIELD_HANDWIRED_CORNE_LEFT || SHIELD_HANDWIRED_CORNE_RIGHT

config ZMK_KEYBOARD_NAME
	default "Handwired Corne"

config ZMK_SPLIT
	default y

if SHIELD_HANDWIRED_CORNE_LEFT

config ZMK_SPLIT_ROLE_CENTRAL
	default y

endif # SHIELD_HANDWIRED_CORNE_LEFT

endif # SHIELD_HANDWIRED_CORNE_LEFT || SHIELD_HANDWIRED_CORNE_RIGHT
```

## boards/shields/handwired_corne/Kconfig.shield
```kconfig
# Copyright (c) 2020 The ZMK Contributors
# SPDX-License-Identifier: MIT

config SHIELD_HANDWIRED_CORNE_LEFT
    def_bool $(shields_list_contains,handwired_corne_left)

config SHIELD_HANDWIRED_CORNE_RIGHT
    def_bool $(shields_list_contains,handwired_corne_right)
```
